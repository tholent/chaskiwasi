// C-1 (framing half): the device's frame codec against vectors generated by
// the host's.
//
// tools/chaskibridge emits test/firmware/host/testdata/frames/vectors.json and
// this parses it. The two codecs are separate implementations in separate
// languages on opposite ends of one cable, and two implementations that merely
// look alike drift silently — the same argument tools/graphvectors makes for
// graphemes (B.7). Here the drift would show up as a device that stops talking
// to the bench harness after an innocuous change to either side.
//
// Regenerate with: go test ./tools/chaskibridge -run TestC1_FrameVectors -update
#include <gtest/gtest.h>

#include <cstdint>
#include <fstream>
#include <memory>
#include <sstream>
#include <string>
#include <vector>

#include "cJSON.h"
#include "chaski/frame.h"

namespace frame = chaski::transport::frame;

namespace {

std::string ReadVectorsFile() {
  const std::string path =
      std::string(CHASKI_TESTDATA_DIR) + "/frames/vectors.json";
  std::ifstream in(path, std::ios::binary);
  EXPECT_TRUE(in) << "missing " << path
                  << " — regenerate with: go test ./tools/chaskibridge "
                     "-run TestC1_FrameVectors -update";
  std::ostringstream ss;
  ss << in.rdbuf();
  return ss.str();
}

std::string FromHex(const std::string& hex) {
  std::string out;
  out.reserve(hex.size() / 2);
  const auto nibble = [](char c) -> int {
    if (c >= '0' && c <= '9') return c - '0';
    if (c >= 'a' && c <= 'f') return c - 'a' + 10;
    if (c >= 'A' && c <= 'F') return c - 'A' + 10;
    return -1;
  };
  for (std::size_t i = 0; i + 1 < hex.size(); i += 2) {
    const int hi = nibble(hex[i]);
    const int lo = nibble(hex[i + 1]);
    if (hi < 0 || lo < 0) continue;
    out.push_back(static_cast<char>((hi << 4) | lo));
  }
  return out;
}

std::string ToHex(const std::string& raw) {
  static const char* kDigits = "0123456789abcdef";
  std::string out;
  out.reserve(raw.size() * 2);
  for (unsigned char c : raw) {
    out.push_back(kDigits[c >> 4]);
    out.push_back(kDigits[c & 0x0f]);
  }
  return out;
}

// A cJSON document that frees itself, so a failing EXPECT cannot leak.
using Doc = std::unique_ptr<cJSON, decltype(&cJSON_Delete)>;

Doc ParseVectors() {
  const std::string text = ReadVectorsFile();
  return Doc(cJSON_ParseWithLength(text.data(), text.size()), &cJSON_Delete);
}

std::string StrField(const cJSON* o, const char* k) {
  const cJSON* v = cJSON_GetObjectItemCaseSensitive(o, k);
  return (cJSON_IsString(v) && v->valuestring != nullptr) ? v->valuestring : "";
}

int IntField(const cJSON* o, const char* k) {
  const cJSON* v = cJSON_GetObjectItemCaseSensitive(o, k);
  return cJSON_IsNumber(v) ? v->valueint : -1;
}

// Drain pulls every complete frame the decoder currently holds.
struct Decoded {
  frame::Type type;
  std::string payload;
};

std::vector<Decoded> Drain(frame::Decoder& d) {
  std::vector<Decoded> out;
  for (;;) {
    Decoded got{};
    if (d.Next(&got.type, &got.payload) != frame::DecodeStatus::kFrame) break;
    out.push_back(std::move(got));
  }
  return out;
}

}  // namespace

// Every generated frame must encode byte-for-byte to what the host emitted.
// This is the direction that catches a layout change on one side only.
TEST(C1, EncodeMatchesHostVectors) {
  Doc doc = ParseVectors();
  ASSERT_TRUE(doc != nullptr) << "vectors.json did not parse";

  const cJSON* frames = cJSON_GetObjectItemCaseSensitive(doc.get(), "frames");
  ASSERT_TRUE(cJSON_IsArray(frames));
  ASSERT_GT(cJSON_GetArraySize(frames), 0);

  const cJSON* f = nullptr;
  cJSON_ArrayForEach(f, frames) {
    const std::string name = StrField(f, "name");
    const std::string payload = FromHex(StrField(f, "payload_hex"));
    const auto type = static_cast<frame::Type>(IntField(f, "type"));

    std::string encoded;
    ASSERT_TRUE(frame::Encode(type, payload, &encoded)) << name;
    EXPECT_EQ(ToHex(encoded), StrField(f, "frame_hex")) << name;
  }
}

// The CRC is what lets a receiver tell a real frame start from a magic that
// happens to appear inside a payload, so both sides must compute it alike.
TEST(C1, Crc32MatchesHostVectors) {
  Doc doc = ParseVectors();
  ASSERT_TRUE(doc != nullptr);

  const cJSON* frames = cJSON_GetObjectItemCaseSensitive(doc.get(), "frames");
  const cJSON* f = nullptr;
  cJSON_ArrayForEach(f, frames) {
    const std::string whole = FromHex(StrField(f, "frame_hex"));
    // Equal, not greater: a zero-length payload is a legitimate frame (the
    // event_empty_payload vector is exactly that), and it is the size at which
    // an off-by-one in the CRC range would show up.
    ASSERT_GE(whole.size(), frame::kOverheadBytes) << StrField(f, "name");

    // The trailer covers [4, 9+n): type, length and payload, never the magic.
    const auto* bytes = reinterpret_cast<const std::uint8_t*>(whole.data());
    const std::size_t covered = whole.size() - frame::kTrailerBytes - 4;
    const std::uint32_t got = frame::Crc32(bytes + 4, covered);

    EXPECT_EQ(got, static_cast<std::uint32_t>(
                       cJSON_GetObjectItemCaseSensitive(f, "crc32")->valuedouble))
        << StrField(f, "name");
  }
}

// Round-tripping each frame on its own proves the decoder agrees about
// boundaries, not merely about bytes.
TEST(C1, DecodeRoundTripsHostVectors) {
  Doc doc = ParseVectors();
  ASSERT_TRUE(doc != nullptr);

  const cJSON* frames = cJSON_GetObjectItemCaseSensitive(doc.get(), "frames");
  const cJSON* f = nullptr;
  cJSON_ArrayForEach(f, frames) {
    const std::string name = StrField(f, "name");
    const std::string whole = FromHex(StrField(f, "frame_hex"));

    frame::Decoder d;
    d.Append(reinterpret_cast<const std::uint8_t*>(whole.data()), whole.size());
    const auto got = Drain(d);

    ASSERT_EQ(got.size(), 1u) << name;
    EXPECT_EQ(static_cast<int>(got[0].type), IntField(f, "type")) << name;
    EXPECT_EQ(ToHex(got[0].payload), StrField(f, "payload_hex")) << name;
    EXPECT_EQ(d.resyncs(), 0u) << name << ": a clean frame needs no resync";
  }
}

// The streams are the cases that actually happen on a shared serial cable:
// console text between frames, a device that rebooted mid-frame, a corrupted
// length, and a magic sitting inside a payload. The decoder must resynchronise
// past all of them and lose nothing that follows.
TEST(C1, DecoderResynchronisesOverHostStreams) {
  Doc doc = ParseVectors();
  ASSERT_TRUE(doc != nullptr);

  const cJSON* streams = cJSON_GetObjectItemCaseSensitive(doc.get(), "streams");
  ASSERT_TRUE(cJSON_IsArray(streams));
  ASSERT_GT(cJSON_GetArraySize(streams), 0);

  const cJSON* s = nullptr;
  cJSON_ArrayForEach(s, streams) {
    const std::string name = StrField(s, "name");
    const std::string stream = FromHex(StrField(s, "stream_hex"));

    frame::Decoder d;
    d.Append(reinterpret_cast<const std::uint8_t*>(stream.data()), stream.size());
    const auto got = Drain(d);

    const cJSON* expect = cJSON_GetObjectItemCaseSensitive(s, "expect");
    ASSERT_TRUE(cJSON_IsArray(expect)) << name;
    ASSERT_EQ(got.size(), static_cast<std::size_t>(cJSON_GetArraySize(expect)))
        << name << ": wrong number of frames recovered";

    std::size_t i = 0;
    const cJSON* e = nullptr;
    cJSON_ArrayForEach(e, expect) {
      EXPECT_EQ(static_cast<int>(got[i].type), IntField(e, "type")) << name << "[" << i << "]";
      EXPECT_EQ(ToHex(got[i].payload), StrField(e, "payload_hex"))
          << name << "[" << i << "]";
      ++i;
    }

    const int want_resyncs = IntField(s, "resyncs");
    if (want_resyncs >= 0) {
      EXPECT_EQ(d.resyncs(), static_cast<std::size_t>(want_resyncs))
          << name << ": resync count is the device's only content-free signal "
                     "that the cable is misbehaving (D-7)";
    }
  }
}

// Feeding the stream one byte at a time must produce the same frames. A
// decoder that only works on whole reads passes every vector above and then
// fails on a real serial port, which delivers whatever it happens to have.
TEST(C1, ByteAtATimeDeliveryIsEquivalent) {
  Doc doc = ParseVectors();
  ASSERT_TRUE(doc != nullptr);

  const cJSON* streams = cJSON_GetObjectItemCaseSensitive(doc.get(), "streams");
  const cJSON* s = nullptr;
  cJSON_ArrayForEach(s, streams) {
    const std::string name = StrField(s, "name");
    const std::string stream = FromHex(StrField(s, "stream_hex"));

    frame::Decoder d;
    std::vector<Decoded> got;
    for (unsigned char c : stream) {
      d.Append(&c, 1);
      for (auto& f : Drain(d)) got.push_back(std::move(f));
    }

    const cJSON* expect = cJSON_GetObjectItemCaseSensitive(s, "expect");
    ASSERT_EQ(got.size(), static_cast<std::size_t>(cJSON_GetArraySize(expect)))
        << name << ": byte-at-a-time recovered a different number of frames";

    std::size_t i = 0;
    const cJSON* e = nullptr;
    cJSON_ArrayForEach(e, expect) {
      EXPECT_EQ(ToHex(got[i].payload), StrField(e, "payload_hex"))
          << name << "[" << i << "]";
      ++i;
    }
  }
}

// A declared length beyond the cap must be refused outright. The length is
// attacker-influenced in the sense that matters here — line noise can forge one
// — and a decoder that trusts it allocates on demand.
TEST(C1, OversizedDeclaredLengthIsRefusedWithoutAllocating) {
  std::string hostile;
  hostile.push_back(static_cast<char>(0x43));  // magic "CHK1"
  hostile.push_back(static_cast<char>(0x48));
  hostile.push_back(static_cast<char>(0x4B));
  hostile.push_back(static_cast<char>(0x31));
  hostile.push_back(static_cast<char>(0x01));  // type
  hostile.push_back(static_cast<char>(0xFF));  // length 0xFFFFFFFF
  hostile.push_back(static_cast<char>(0xFF));
  hostile.push_back(static_cast<char>(0xFF));
  hostile.push_back(static_cast<char>(0xFF));

  frame::Decoder d;
  d.Append(reinterpret_cast<const std::uint8_t*>(hostile.data()), hostile.size());

  frame::Type type{};
  std::string payload;
  EXPECT_EQ(d.Next(&type, &payload), frame::DecodeStatus::kNeedMoreBytes);

  // A real frame after the hostile header must still be found.
  std::string good;
  ASSERT_TRUE(frame::Encode(frame::Type::kRequest, "hello", &good));
  d.Append(reinterpret_cast<const std::uint8_t*>(good.data()), good.size());

  const auto got = Drain(d);
  ASSERT_EQ(got.size(), 1u);
  EXPECT_EQ(got[0].payload, "hello");
  EXPECT_GT(d.resyncs(), 0u);
}
